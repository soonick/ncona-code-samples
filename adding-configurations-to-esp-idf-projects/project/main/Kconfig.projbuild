## adding-configurations-to-esp-idf-projects/project/main/Kconfig.projbuild
```kconfig
menu "Project config"
config PERSON_NAME
        string "Person Name"
        default "Jose"
        help
            The code will greet this person
endmenu
```
